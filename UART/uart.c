#include "uart.h"
sbit LED 				= P3^2;		  /*µ¥Æ¬»ú3.6Òý½Å¿ØÖÆ¼ÌµçÆ÷COM2*/

uint8 TBUF,RBUF;
uint8 TDAT,RDAT;
uint8 TCNT,RCNT;
uint8 TBIT,RBIT;
/*
const uint8 s_CRCHi[] = {
    0x00, 0xC1, 0x81, 0x40, 0x01, 0xC0, 0x80, 0x41, 0x01, 0xC0,
    0x80, 0x41, 0x00, 0xC1, 0x81, 0x40, 0x01, 0xC0, 0x80, 0x41,
    0x00, 0xC1, 0x81, 0x40, 0x00, 0xC1, 0x81, 0x40, 0x01, 0xC0,
    0x80, 0x41, 0x01, 0xC0, 0x80, 0x41, 0x00, 0xC1, 0x81, 0x40,
    0x00, 0xC1, 0x81, 0x40, 0x01, 0xC0, 0x80, 0x41, 0x00, 0xC1,
    0x81, 0x40, 0x01, 0xC0, 0x80, 0x41, 0x01, 0xC0, 0x80, 0x41,
    0x00, 0xC1, 0x81, 0x40, 0x01, 0xC0, 0x80, 0x41, 0x00, 0xC1,
    0x81, 0x40, 0x00, 0xC1, 0x81, 0x40, 0x01, 0xC0, 0x80, 0x41,
    0x00, 0xC1, 0x81, 0x40, 0x01, 0xC0, 0x80, 0x41, 0x01, 0xC0,
    0x80, 0x41, 0x00, 0xC1, 0x81, 0x40, 0x00, 0xC1, 0x81, 0x40,
    0x01, 0xC0, 0x80, 0x41, 0x01, 0xC0, 0x80, 0x41, 0x00, 0xC1,
    0x81, 0x40, 0x01, 0xC0, 0x80, 0x41, 0x00, 0xC1, 0x81, 0x40,
    0x00, 0xC1, 0x81, 0x40, 0x01, 0xC0, 0x80, 0x41, 0x01, 0xC0,
    0x80, 0x41, 0x00, 0xC1, 0x81, 0x40, 0x00, 0xC1, 0x81, 0x40,
    0x01, 0xC0, 0x80, 0x41, 0x00, 0xC1, 0x81, 0x40, 0x01, 0xC0,
    0x80, 0x41, 0x01, 0xC0, 0x80, 0x41, 0x00, 0xC1, 0x81, 0x40,
    0x00, 0xC1, 0x81, 0x40, 0x01, 0xC0, 0x80, 0x41, 0x01, 0xC0,
    0x80, 0x41, 0x00, 0xC1, 0x81, 0x40, 0x01, 0xC0, 0x80, 0x41,
    0x00, 0xC1, 0x81, 0x40, 0x00, 0xC1, 0x81, 0x40, 0x01, 0xC0,
    0x80, 0x41, 0x00, 0xC1, 0x81, 0x40, 0x01, 0xC0, 0x80, 0x41,
    0x01, 0xC0, 0x80, 0x41, 0x00, 0xC1, 0x81, 0x40, 0x01, 0xC0,
    0x80, 0x41, 0x00, 0xC1, 0x81, 0x40, 0x00, 0xC1, 0x81, 0x40,
    0x01, 0xC0, 0x80, 0x41, 0x01, 0xC0, 0x80, 0x41, 0x00, 0xC1,
    0x81, 0x40, 0x00, 0xC1, 0x81, 0x40, 0x01, 0xC0, 0x80, 0x41,
    0x00, 0xC1, 0x81, 0x40, 0x01, 0xC0, 0x80, 0x41, 0x01, 0xC0,
    0x80, 0x41, 0x00, 0xC1, 0x81, 0x40
} ;

const uint8 s_CRCLo[] = {
	0x00, 0xC0, 0xC1, 0x01, 0xC3, 0x03, 0x02, 0xC2, 0xC6, 0x06,
	0x07, 0xC7, 0x05, 0xC5, 0xC4, 0x04, 0xCC, 0x0C, 0x0D, 0xCD,
	0x0F, 0xCF, 0xCE, 0x0E, 0x0A, 0xCA, 0xCB, 0x0B, 0xC9, 0x09,
	0x08, 0xC8, 0xD8, 0x18, 0x19, 0xD9, 0x1B, 0xDB, 0xDA, 0x1A,
	0x1E, 0xDE, 0xDF, 0x1F, 0xDD, 0x1D, 0x1C, 0xDC, 0x14, 0xD4,
	0xD5, 0x15, 0xD7, 0x17, 0x16, 0xD6, 0xD2, 0x12, 0x13, 0xD3,
	0x11, 0xD1, 0xD0, 0x10, 0xF0, 0x30, 0x31, 0xF1, 0x33, 0xF3,
	0xF2, 0x32, 0x36, 0xF6, 0xF7, 0x37, 0xF5, 0x35, 0x34, 0xF4,
	0x3C, 0xFC, 0xFD, 0x3D, 0xFF, 0x3F, 0x3E, 0xFE, 0xFA, 0x3A,
	0x3B, 0xFB, 0x39, 0xF9, 0xF8, 0x38, 0x28, 0xE8, 0xE9, 0x29,
	0xEB, 0x2B, 0x2A, 0xEA, 0xEE, 0x2E, 0x2F, 0xEF, 0x2D, 0xED,
	0xEC, 0x2C, 0xE4, 0x24, 0x25, 0xE5, 0x27, 0xE7, 0xE6, 0x26,
	0x22, 0xE2, 0xE3, 0x23, 0xE1, 0x21, 0x20, 0xE0, 0xA0, 0x60,
	0x61, 0xA1, 0x63, 0xA3, 0xA2, 0x62, 0x66, 0xA6, 0xA7, 0x67,
	0xA5, 0x65, 0x64, 0xA4, 0x6C, 0xAC, 0xAD, 0x6D, 0xAF, 0x6F,
	0x6E, 0xAE, 0xAA, 0x6A, 0x6B, 0xAB, 0x69, 0xA9, 0xA8, 0x68,
	0x78, 0xB8, 0xB9, 0x79, 0xBB, 0x7B, 0x7A, 0xBA, 0xBE, 0x7E,
	0x7F, 0xBF, 0x7D, 0xBD, 0xBC, 0x7C, 0xB4, 0x74, 0x75, 0xB5,
	0x77, 0xB7, 0xB6, 0x76, 0x72, 0xB2, 0xB3, 0x73, 0xB1, 0x71,
	0x70, 0xB0, 0x50, 0x90, 0x91, 0x51, 0x93, 0x53, 0x52, 0x92,
	0x96, 0x56, 0x57, 0x97, 0x55, 0x95, 0x94, 0x54, 0x9C, 0x5C,
	0x5D, 0x9D, 0x5F, 0x9F, 0x9E, 0x5E, 0x5A, 0x9A, 0x9B, 0x5B,
	0x99, 0x59, 0x58, 0x98, 0x88, 0x48, 0x49, 0x89, 0x4B, 0x8B,
	0x8A, 0x4A, 0x4E, 0x8E, 0x8F, 0x4F, 0x8D, 0x4D, 0x4C, 0x8C,
	0x44, 0x84, 0x85, 0x45, 0x87, 0x47, 0x46, 0x86, 0x82, 0x42,
	0x43, 0x83, 0x41, 0x81, 0x80, 0x40
};
*/
bit TING,RING;
bit TEND,REND;
uint8 TCNT,RCNT;

uint8 add;  
uint8 j=0;
uint8 dat=0X00;    
bit flag_zx=0;
bit bz1=0;
bit bz2=0;
bit bz3=0;
bit bz4=0;
bit bz5=0;
bit bz6=0;
bit bz7=0;
bit bz8=0;
uint8 sendPosi=0; 
uint8 receCount=0;   
uint8 sendCount=0;   
uint8 receTimeOut=0; 
uint8 byteCount=5;   

uint8 sendBuf[10];	 
uint8 receBuf[10];   

MODS_T g_tModS;
VAR_T g_tVar;
/*************************************************************************/
/* 串口1配置函数，baud-通信波特率 */
void ConfigUART1()
{
  RS485_DIR = 0; //RS485设置为接收方向
	
	TING=0;
	RING=0;
	TEND=1;
	REND=0;
	TCNT=0;
	RCNT=0;
}

void UART_CYC()
{

	if(RING)
	{
		if(--RCNT==0){
			RCNT=3;
			if(--RBIT==0){
				RBUF=RDAT;
				RING=0;
				REND=1;
			}
			else{
				RDAT>>=1;
				if(RXB) 
					RDAT|=0X80;
			}
		}
	}
	else if(!RXB){
		RING=1;
		RCNT=4;
		RBIT=9;
	}
	if(--TCNT==0)
	{
		TCNT=3;
		if(TING){
			if(TBIT==0){
				TXB=0;
				TDAT=TBUF;
				TBIT=9;
			}
			else
			{
				TDAT>>=1;
				if(--TBIT==0){
					TXB=1;
					TING=0;
					TEND=1;
				}
				else
					TXB = CY;
			}
		}
	}
}

///Read coil status
void MODS_01H(void)
{

	uint16 reg;
	uint16 num;
	uint16 i;
	uint16 m;
	uint8 status[10];
	
	g_tModS.RspCode = RSP_OK;

	if (g_tModS.RxCount != 8)
	{
		g_tModS.RspCode = RSP_ERR_VALUE;
		return;
	}

	reg = BEBufToUint16(&g_tModS.RxBuf[2]); 
	num = BEBufToUint16(&g_tModS.RxBuf[4]);	
	m = (num + 7) / 8;
	
	
	if(num>COIL_NUM){
		g_tModS.RspCode = RSP_ERR_REG_ADDR;
		goto err_ret;
	}
		
		
	for (i = 0; i < m; i++)
		status[i] = 0;
	
	for (i = 0; i < num; i++)
	{
		if(reg<(COIL_BASE+COIL_NUM)){
			if(g_tVar.Coils[reg-COIL_BASE]==1){
				status[i / 8] |= (1 << (i % 8));
			}
		}
		else{		
				g_tModS.RspCode = RSP_ERR_REG_ADDR;
				break;
		}
		reg++;
	}

	err_ret:
	if (g_tModS.RspCode == RSP_OK)
	{
		g_tModS.TxCount = 0;
		g_tModS.TxBuf[g_tModS.TxCount++] = g_tModS.RxBuf[0];
		g_tModS.TxBuf[g_tModS.TxCount++] = g_tModS.RxBuf[1];
		g_tModS.TxBuf[g_tModS.TxCount++] = m;	
		g_tModS.TxBuf[3] = 0;
		g_tModS.TxBuf[4] = 0;
		g_tModS.TxBuf[5] = 0;
		g_tModS.TxBuf[6] = 0;
		
		
		for (i = 0; i < m; i++)
		{
			g_tModS.TxBuf[g_tModS.TxCount++] = status[i];
		}
		MODS_SendWithCRC(g_tModS.TxBuf, g_tModS.TxCount);
	}
	else
	{
		;
		MODS_SendAckErr(g_tModS.RspCode);	
	}
}


void MODS_02H(void)
{
	uint16 reg;
	uint16 num;
	uint16 i;
	uint16 m;
	uint8 status[10];

	g_tModS.RspCode = RSP_OK;

	if (g_tModS.RxCount != 8)
	{
		g_tModS.RspCode = RSP_ERR_VALUE;
		return;
	}

	reg = BEBufToUint16(&g_tModS.RxBuf[2]); 
	num = BEBufToUint16(&g_tModS.RxBuf[4]);	

	m = (num + 7) / 8;
	
	
	if(num>DI_NUM){
		g_tModS.RspCode = RSP_ERR_REG_ADDR;
		goto err_ret;
	}
		
		
	for (i = 0; i < m; i++)
		status[i] = 0;
	
	for (i = 0; i < num; i++)
	{
		if(reg<(DI_BASE+DI_NUM)){
			if(g_tVar.Inputs[reg-DI_BASE]==1){
				status[i / 8] |= (1 << (i % 8));
			}
		}
		else{		
				g_tModS.RspCode = RSP_ERR_REG_ADDR;
				break;
		}
		reg++;
	}

	err_ret:
	if (g_tModS.RspCode == RSP_OK)
	{
		g_tModS.TxCount = 0;
		g_tModS.TxBuf[g_tModS.TxCount++] = g_tModS.RxBuf[0];
		g_tModS.TxBuf[g_tModS.TxCount++] = g_tModS.RxBuf[1];
		g_tModS.TxBuf[g_tModS.TxCount++] = m;

		for (i = 0; i < m; i++)
		{
			g_tModS.TxBuf[g_tModS.TxCount++] = status[i];
		}
		MODS_SendWithCRC(g_tModS.TxBuf, g_tModS.TxCount);
	}
	else
	{
		MODS_SendAckErr(g_tModS.RspCode);
	}
}

void MODS_0FH(void)
{

	uint16 reg;
	uint16 _ByteNum=0;
	uint16 _coilnum;
	uint8 * p;
	int8 * varAdr;
	int8 ireg;

	g_tModS.RspCode = RSP_OK;
	
	if (g_tModS.RxCount < 8)
	{
		g_tModS.RspCode = RSP_ERR_VALUE;		/* error frame*/
		goto err_ret;
	}
	reg = BEBufToUint16(&g_tModS.RxBuf[2]); 	/*start address*/
	_coilnum = BEBufToUint16(&g_tModS.RxBuf[4]);	/* êy?Y */	
	_ByteNum = g_tModS.RxBuf[6];
	
	p = &g_tModS.RxBuf[7];
	
	varAdr = &g_tVar.Coils[reg-COIL_BASE];
	
	if ((reg+_coilnum)<(COIL_BASE+COIL_NUM))
	{
		for(ireg=0;ireg<_coilnum;ireg++){
			* (varAdr+ireg) = (*(p + (int)(ireg / 8) ) >> (int)(ireg % 8)) & (0x01);	
		}
	}
	else
	{
		g_tModS.RspCode = RSP_ERR_REG_ADDR;	
	}
err_ret:
	if (g_tModS.RspCode == RSP_OK)
	{
		MODS_SendAckOk();
	}
	else
	{
		MODS_SendAckErr(g_tModS.RspCode);
	}
}

void MODS_05H(void)
{
	uint16 reg;
	uint16 value;

	g_tModS.RspCode = RSP_OK;
	
	if (g_tModS.RxCount != 8)
	{
		g_tModS.RspCode = RSP_ERR_VALUE;
		goto err_ret;
	}

	reg = BEBufToUint16(&g_tModS.RxBuf[2]); 
	value = BEBufToUint16(&g_tModS.RxBuf[4]);	
	
	if (value != 0x0000 && value != 0xFF00)
	{
		g_tModS.RspCode = RSP_ERR_VALUE;
		goto err_ret;
	}
	
	if (reg<(COIL_BASE+COIL_NUM))
	{
		g_tVar.Coils[reg-COIL_BASE] = (value==0xFF00);
	}
	else
	{
		g_tModS.RspCode = RSP_ERR_REG_ADDR;	
	}
err_ret:
	if (g_tModS.RspCode == RSP_OK)
	{
		MODS_SendAckOk();
	}
	else
	{
		MODS_SendAckErr(g_tModS.RspCode);	
	}
}


void MODS_SendAckOk(void)
{
	uint8 txbuf[6];
	uint8 i;

	for (i = 0; i < 6; i++)
	{
		txbuf[i] = g_tModS.RxBuf[i];
	}
	MODS_SendWithCRC(txbuf, 6);
}
uint16 CRC16_Modbus(uint8 *_pBuf, uint16 _usLen)
{
	
	uint8 i;
	int8 n;
	uint16 crc = 0xffff;
	uint16 polynom = 0xA001;
	
	
	if (_usLen == 0) {
		_usLen = 1;
	}
	for (n = 0; n<_usLen; n++) {/*此处的6 -- 要校验的位数为6个*/
		crc = _pBuf[n] ^ crc;
		for (i = 0; i < 8; i++) {  /*此处的8 -- 指每一个char类型又8bit，每bit都要处理*/
			if (crc & 0x01) {
				crc = crc >> 1;
				crc = crc ^ 0xA001;
			}
			else {
				crc = crc >> 1;
			}
		}
	}
	return(crc);
}

uint16 BEBufToUint16(uint8 *_pBuf)
{
    return (((uint16)_pBuf[0] << 8) | _pBuf[1]);
}

void MODS_SendWithCRC(uint8 *_pBuf, uint8 _ucLen)
{
	uint16 crc=0xFFFF;
	uint8 buf[S_TX_BUF_SIZE];
	int8 n,i;
	
	memcpy(buf, _pBuf, _ucLen);

	for (n = 0; n<_ucLen; n++) {
		crc = buf[n] ^ crc;
		for (i = 0; i < 8; i++) {
			if (crc & 0x01) {
				crc = crc >> 1;
				crc = crc ^ 0xA001;
			}
			else {
				crc = crc >> 1;
			}
		}
	}
	buf[_ucLen++] = crc;
	buf[_ucLen++] = crc >> 8;
	
	RS485_SendBuf(buf, _ucLen);

}

void MODS_SendAckErr(uint8 _ucErrCode)
{
	uint8 txbuf[3];

	txbuf[0] = g_tModS.RxBuf[0];					
	txbuf[1] = g_tModS.RxBuf[1] | 0x80;		
	txbuf[2] = _ucErrCode;							

	MODS_SendWithCRC(txbuf, 3);
}


void RS485_SendBuf(uint8 *_ucaBuf, uint16 _usLen)
{
	uint16 ii,t;
	for(ii=0;ii<_usLen;ii++)
	{
		if(TEND)	  //允许发送
		{
			 TEND=0;
			 TBUF= _ucaBuf[t++&0x0F];
			 TING=1;
		}
		while(!TEND);
	}
	t=0;
	RS485_DIR=0;
	
}


